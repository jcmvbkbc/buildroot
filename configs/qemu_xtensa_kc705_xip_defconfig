## configs/qemu_xtensa_kc705_xip_defconfig
```kconfig
BR2_xtensa=y
BR2_XTENSA_DYNCONFIG=y
BR2_TOOLCHAIN_EXTERNAL=y
BR2_TOOLCHAIN_EXTERNAL_PATH="/home/jcmvbkbc/ws/tensilica/uclibc/build-xtensa-fdpic-toolchain/root"
BR2_TOOLCHAIN_EXTERNAL_CUSTOM_PREFIX="$(ARCH)-linux-uclibcfdpic"
BR2_TOOLCHAIN_EXTERNAL_HEADERS_6_1=y
# BR2_TOOLCHAIN_EXTERNAL_HAS_THREADS is not set
BR2_RELRO_NONE=y
BR2_PACKAGE_BUSYBOX_CONFIG="board/qemu/xtensa-kc705/busybox-xip.config"
BR2_TARGET_ROOTFS_CRAMFS=y
BR2_TARGET_ROOTFS_CRAMFS_XIP=y
```
